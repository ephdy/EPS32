/*
    1. Fundamental Command
    0   81 A[7:0]       设置对比度，范围1-256，RESET = 7Fh 
    0   A4/A5           恢复到RAM内容显示/显示屏全部打开
    0   A6/A7           正常显示/反显
    0   AE/AF           显示器关/开
    2. Scrolling Command
    0   26/27           左/右水平滚动
    0
    0
    3. Addressing Setting Command
    0   00-0F           设置页面寻址模式的列地址的低四位
                        此命令仅用于页面寻址模式
    0   10-1F           设置页面寻址模式的列地址的高四位
                        此命令仅用于页面寻址模式
    0   20 A[1:0]       设置内存寻址模式
                        A[1:0]=00b，水平寻址模式
                        A[1:0]=01b，垂直寻址模式
                        A[1:0]=10b，页面寻址模式（重置）
                        A[1:0]=11b，无效
    0   21 A[6:0] B[6:0]设置列的起始和结束地址
                        A[6:0]：列起始地址，范围:0-127d，RESET=0d
                        B[6:0]：列结束地址，范围:0-127d，RESET=127d
                        此命令仅适用于水平或垂直寻址模式
    0   22 A[2:0] B[2:0]设置页的起始和结束地址
                        A[2:0]：页起始地址，范围：0-7d,RESET=0d
                        B[2:0]：页结束地址，范围：0-7d,RESET=7d
                        此命令仅适用于水平或垂直寻址模式
    0   B0-B7           为页面寻址模式设置页面起始地址,PAGE0~PAGE7
    4. Hardware Configuration (Panel resolution & layout related) Command
    0   40-7F
    0   A0/A1
    0   A8 A[5:0]
    0   C0/C8
    0   D3 A[5:0]
    0   DA A[5:4]
    5. Timing & Driving Scheme Setting Command
    0   D5 A[7:0]       设置显示时钟分频比/振荡器频率
                        A[3:0]：定义显示时钟（DCLK）的分频比（D）：分频比=A[3:0]+1，RESET为0000b（分频比=1）
                        A[7:4]：设置振荡器频率FOSC。振荡器频率随着A[7:4]的值而增加，反之亦然。重置为1000b。范围：0000b~1111b
    0   D9 A[7:0]       设置预充电期
    0   DB A[6:4]
    0   E3              无操作命令
*/

#include "OLED_SPI_BUFFER.h"

/*宽8像素，高16像素*/

const uint8_t oled_f16x8[][16] =
{
	{0x00,0x00,0x00,0x00,0x00,0x00,0x00,0x00},
	{0x00,0x00,0x00,0x00,0x00,0x00,0x00,0x00},//   0
	{0x00,0x00,0x00,0xF8,0x00,0x00,0x00,0x00},
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	{0x00,0x00,0x00,0x00,0x00,0x01,0x01,0x00},// ~ 94
};

/*宽6像素，高8像素*/

const uint8_t oled_f8x6[][6] = 
{
	{0x00,0x00,0x00,0x00,0x00,0x00},//   0
	{0x00,0x00,0x00,0x2F,0x00,0x00},// ! 1
	{0x00,0x00,0x07,0x00,0x07,0x00},// " 2
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	{0x00,0x08,0x04,0x08,0x10,0x08},// ~ 94
};
/*********************ASCII字模数据*/

uint8_t oled_disply_buffer[8][4][32]={0};

spi_device_handle_t spi;

void lcd_spi_pre_transfer_callback(spi_transaction_t *t)
{
    int dc = (int)t->user;
    gpio_set_level(PIN_NUM_D, dc);
}

void spi_init(){
    
    for (int i = 0; i < 1000; i ++)
	{
		for (int j = 0; j < 1000; j ++);
	}

    
    spi_bus_config_t bus_cfg={
        .miso_io_num = PIN_NUM_MISO,
        .mosi_io_num = PIN_NUM_MOSI,
        .sclk_io_num = PIN_NUM_CLK,
        .quadwp_io_num = -1,
        .quadhd_io_num = -1,
        .max_transfer_sz = 4092,
    };

    spi_device_interface_config_t dev_cfg = {
        .clock_speed_hz = 10 * 1000 * 1000,     //Clock out at 10 MHz
        .mode = 0,                              //SPI mode 0
        .spics_io_num = PIN_NUM_CS,             //CS pin
        .queue_size = 7,                        //We want to be able to queue 7 transactions at a time
        .pre_cb = lcd_spi_pre_transfer_callback, //Specify pre-transfer callback to handle D/C line
    };

    ESP_ERROR_CHECK(spi_bus_initialize(OLED_HOST, &bus_cfg, SPI_DMA_CH_AUTO));
    ESP_ERROR_CHECK(spi_bus_add_device(OLED_HOST,&dev_cfg, &spi));

    gpio_config_t dc_cfg={
        .pin_bit_mask=(1<<GPIO_NUM_2),
        .pull_up_en=GPIO_PULLDOWN_DISABLE,
        .pull_down_en=GPIO_PULLDOWN_DISABLE,
        .mode=GPIO_MODE_OUTPUT,
        .intr_type=GPIO_INTR_DISABLE,
    };
    gpio_config(&dc_cfg);
    dc_cfg.pin_bit_mask=(1<<GPIO_NUM_4);
    gpio_config(&dc_cfg);  
}


void oled_reset(){
    RES_ON;
    for (int i = 0; i < 1000; i ++)
	{
		for (int j = 0; j < 1000; j ++);
	}
    RES_OFF;
}

void oled_init(){
    spi_init();

    oled_reset();

    uint8_t data[23];  //定义要发送过去的数据
	data[0] = 0xAE;     //设置显示开启/关闭，0xAE关闭，0xAF开启
	data[1] = 0xD5;     //设置显示时钟分频比/振荡器频率
	data[2] = 0x80;     //0x00~0xFF
    data[3] = 0xA8;     //设置多路复用率
    data[4] = 0x3F;     //0x0E~0x3F
    data[5] = 0xD3;     //设置显示偏移
    data[6] = 0x00;     //0x00~0x7F
    data[7] = 0x40;     //设置显示开始行，0x40~0x7F
    data[8] = 0xA1;     //设置左右方向，0xA1正常，0xA0左右反置
	data[9] = 0xC8;     //设置上下方向，0xC8正常，0xC0上下反置
	data[10] = 0xDA;    //设置COM引脚硬件配置
    data[11] = 0x12;
    data[12] = 0x81;    //设置对比度
    data[13] = 0xCF;    //0x00~0xFF
    data[14] = 0xD9;    //设置预充电周期
    data[15] = 0xF1;
    data[16] = 0xDB;    //设置VCOMH取消选择级别
    data[17] = 0x30;
    data[18] = 0xA4;    //设置整个显示打开/关闭
    data[19] = 0xA6;    //设置正常/反色显示，0xA6正常，0xA7反色
    data[20] = 0x8D;    //设置充电泵
    data[21] = 0x14;    //开启显示
    data[22] = 0xAF;


    spi_transaction_t trans_cfg; //定义数据结构体
	memset(&trans_cfg, 0, sizeof(trans_cfg));  //为数据结构体分配内存
	trans_cfg.cmd = 0x9F; //因为是固定内存地址，使用的是nterface_config的配置，也就是8bit cmd，0bit address
	trans_cfg.length = 23 * 8;  //要发送或者接收的数据的长度，不算前面的cmd/address/dummy的长度
	trans_cfg.tx_buffer =data;  //发送没有指定内部空间，使用的是外部区域，因此要自己指定
	trans_cfg.rx_buffer = NULL; //接收定义了SPI_TRANS_USE_RXDATA，使用的是内部空间。
	trans_cfg.flags = SPI_TRANS_USE_RXDATA;


    spi_device_polling_transmit(spi, &trans_cfg);
}



void oled_write_byte(uint8_t chr){
    spi_transaction_t trans_cfg; //定义数据结构体
    memset(&trans_cfg, 0, sizeof(trans_cfg));  //为数据结构体分配内存
    trans_cfg.cmd = 0x9F; //因为是固定内存地址，使用的是nterface_config的配置，也就是8bit cmd，0bit address
    trans_cfg.length = 1 * 8;  //要发送或者接收的数据的长度，不算前面的cmd/address/dummy的长度
    trans_cfg.tx_buffer =&chr;  //发送没有指定内部空间，使用的是外部区域，因此要自己指定
    trans_cfg.rx_buffer = NULL; //接收定义了SPI_TRANS_USE_RXDATA，使用的是内部空间。
    trans_cfg.flags = SPI_TRANS_USE_RXDATA;

    spi_device_polling_transmit(spi, &trans_cfg);
}

void oled_write_bytes(uint8_t chr[],uint8_t n){
    spi_transaction_t trans_cfg; //定义数据结构体
    memset(&trans_cfg, 0, sizeof(trans_cfg));  //为数据结构体分配内存
    trans_cfg.cmd = 0x9F; //因为是固定内存地址，使用的是nterface_config的配置，也就是8bit cmd，0bit address
    trans_cfg.length = n * 8;  //要发送或者接收的数据的长度，不算前面的cmd/address/dummy的长度
    trans_cfg.tx_buffer =chr;  //发送没有指定内部空间，使用的是外部区域，因此要自己指定
    trans_cfg.rx_buffer = NULL; //接收定义了SPI_TRANS_USE_RXDATA，使用的是内部空间。
    trans_cfg.flags = SPI_TRANS_USE_RXDATA;

    spi_device_polling_transmit(spi, &trans_cfg);
}


void oled_set_cursor(uint8_t Page,uint8_t Coul){
    DC_Command;
    uint8_t xy[]={0x00|(Coul&0x0F),0x10|((Coul&0xF0)>>4),0xB0|Page};
    oled_write_bytes(xy,3);
}

uint8_t clr[4][32]={0};
void oled_clr(){
	for (uint8_t i = 0; i < 8; i++)
    {
		oled_set_cursor(i,0);
        DC_Data;
		for (uint8_t i = 0; i < 4; i++)
		{
			oled_write_bytes(clr[i],32);
		}
	}
}



/*
void oled_clr(){
	for (uint8_t i = 0; i < 8; i++)
    {
        oled_set_cursor(i,0);
        DC_Data;
        for (uint8_t j = 0; j < 128; j++)
        {
            oled_write_byte(0x00);
	    }
    }
}
*/
void oled_write_buffer(uint8_t Page,uint8_t Coul,uint8_t data){
	oled_disply_buffer[Page][Coul/32][Coul%32]=data;
}

void oled_update(){
	for (uint8_t i = 0; i < 8; i++)
    {
		oled_set_cursor(i,0);
        DC_Data;
		for (uint8_t j = 0; j < 4; j++)
		{
			oled_write_bytes(oled_disply_buffer[i][j],32);
		}
	}
}



void oled_witre_char(uint8_t Page,uint8_t Coul,uint8_t chr,uint8_t width){
    switch (width)
    {
    case 6://字符宽度6
        for (uint8_t i = 0; i < 6; i++)
        {
            oled_write_buffer(Page,Coul+i,oled_f8x6[chr-' '][i]);
        }
        break;
	case 8://字符宽度8
        for (uint8_t i = 0; i < 8; i++)
        {
            oled_write_buffer(Page,Coul+i,oled_f16x8[(chr-' ')*2][i]);
			oled_write_buffer(Page+1,Coul+i,oled_f16x8[(chr-' ')*2+1][i]);
        }
        break;
	
    default:
        break;
    }
}

void oled_witre_string(uint8_t Page,uint8_t Coul,char *str,uint8_t width){
    for (uint8_t i = 0;str[i]!='\0'; i++)
    {
        oled_witre_char(Page,Coul+i*width,str[i],width);
    }
}
